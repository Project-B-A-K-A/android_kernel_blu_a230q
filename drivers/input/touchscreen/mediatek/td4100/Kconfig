## drivers/input/touchscreen/mediatek/td4100/Kconfig
```kconfig
#
# Touchscreen driver configuration
#

config TOUCHSCREEN_SYNAPTICS_DSX_I2C
	bool "SY4100 for Mediatek package"
	default n
	help
	Say Y here if you have SY4100 touch panel TOUCHSCREEN_SYNAPTICS_DSX_I2C.

	If unsure, say N.

	To compile this dirver as a module, choose M here: the
	module will be called.

config TOUCHSCREEN_SYNAPTICS_RMI_DEV
	bool "SY4100 for Mediatek package"
	default n
	help
	Say Y here if you have SY4100 touch panel TOUCHSCREEN_SYNAPTICS_RMI_DEV.

	If unsure, say N.

	To compile this dirver as a module, choose M here: the
	module will be called.

config TOUCHSCREEN_SYNAPTICS_FW_UPDATE
	bool "SY4100 for Mediatek package"
	default n
	help
	Say Y here if you have SY4100 touch panel TOUCHSCREEN_SYNAPTICS_FW_UPDATE.

	If unsure, say N.

	To compile this dirver as a module, choose M here: the
	module will be called.
```

## drivers/misc/mediatek/efuse_starmen/Kconfig
```kconfig
config MTK_SECURITY_SW_SUPPORT
	bool "show efuse status"
	default n
	---help---
	  show efuse status
```

## drivers/misc/mediatek/magnetometer/akm0991x/Kconfig
```kconfig
config MTK_AKM0991X
	bool "AKM0991X for MediaTek package"
	default n
	help
	  It support different magnetometer sensor.
          If this option is set,
	  it will support
          AKMD0991X magnetometer.
```
